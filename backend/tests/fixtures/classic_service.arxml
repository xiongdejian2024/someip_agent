AUTOSAR XML (schema 4.0)
package /Classic
  base type Word: base-type-size=16, base-type-encoding=NONE
  sender receiver interface DoorStatus
    data Position: type=/Classic/Word
  client server interface DoorControl
    operation UnrelatedFirstOperation
    operation SetDoor
      arg Target: type=/Classic/Word, direction=IN
      arg Actual: type=/Classic/Word, direction=OUT
  provided service instance BodyService: instance-identifier=2, service-identifier=0x1234, sd-server-config={server-service-major-version=1, server-service-minor-version=0}
  pdu triggering UnrelatedEventTrigger: pdu=EventPdu
  pdu triggering UnrelatedCallTrigger: pdu=CallPdu
  pdu triggering UnrelatedReturnTrigger: pdu=ReturnPdu
  pdu EventPdu
    signal EventSignal: start 0, system signal EventSystemSignal, data-transformations=/Classic/Transformation, someip-transformation-i-signal-props{transformer=/Classic/Transformer, session-handling-sr=SESSION-HANDLING-ACTIVE, message-type=2}
  pdu CallPdu
    signal CallSignal: start 0, system signal CallSystemSignal, data-transformations=/Classic/Transformation
  pdu ReturnPdu
    signal ReturnSignal: start 0, system signal ReturnSystemSignal, data-transformations=/Classic/Transformation
  data transformation Transformation: transformer-chain=/Classic/Transformer
  transformation technology Transformer: protocol=SOMEIP, version=1.0.0, transformer-class=SERIALIZER, buffer-properties=header-length=64, someip-transformation-description{alignment=64, byte-order=big-endian, interface-version=1}
package /Other
  sender receiver interface DoorStatus
    data WrongPosition: type=/Classic/Word
