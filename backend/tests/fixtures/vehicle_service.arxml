AUTOSAR XML (schema 00048)
standard types defined: uint8, boolean
package /DataTypes
  4 x base type, all with category=FIXED_LENGTH:
    UnsignedWord: base-type-size=16, base-type-encoding=NONE
    UnsignedByte: base-type-size=8, base-type-encoding=NONE
    LogicalByte: base-type-size=8, base-type-encoding=BOOLEAN
    RealSingle: base-type-size=32, base-type-encoding=IEEE754
  impl type uint16_kph: category=VALUE, base-type=/DataTypes/UnsignedWord
  impl type float32_kph: category=VALUE, base-type=/DataTypes/RealSingle
package /Interfaces
  service interface VehicleStatus
    methods:
      operation SetSpeed
        arg Speed: type=/DataTypes/uint16_kph, direction=IN
        arg Accepted: type=/DataTypes/boolean, direction=OUT
    events:
      data SpeedChanged: type=/DataTypes/float32_kph
    field IgnitionState
      data IgnitionState: type=/DataTypes/uint8
package /Deployment
  someip service interface deployment VehicleStatusDeployment: service-interface=/Interfaces/VehicleStatus, service-interface-id=0x1234, major-version=1, minor-version=2
    someip method deployment SetSpeedDeployment: method=/Interfaces/VehicleStatus/SetSpeed, method-id=0x0001
    someip event deployment SpeedChangedDeployment: event=/Interfaces/VehicleStatus/SpeedChanged, event-id=0x8001
    someip field deployment IgnitionStateDeployment: field=/Interfaces/VehicleStatus/IgnitionState, getter-id=0x0101, setter-id=0x0102, notifier-id=0x8101
    someip event group VehicleEvents: event-group-id=0x0001, event=/Interfaces/VehicleStatus/SpeedChanged, field-deployment=/Deployment/VehicleStatusDeployment/IgnitionStateDeployment
  provided someip service instance VehicleStatusInstance: service-interface-deployment=/Deployment/VehicleStatusDeployment, service-instance-id=0x0001
