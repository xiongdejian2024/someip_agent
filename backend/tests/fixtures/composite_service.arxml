AUTOSAR XML (schema 4.0)
package /Composite
  base type Byte: category=FIXED_LENGTH, base-type-size=8, base-type-encoding=NONE
  base type Word: category=FIXED_LENGTH, base-type-size=16, base-type-encoding=NONE
  base type SignedWord: category=FIXED_LENGTH, base-type-size=16, base-type-encoding=2C
  8 x impl type:
    ByteValue: category=VALUE, base-type=/Composite/Byte
    WordValue: category=VALUE, base-type=/Composite/Word
    SignedValue: category=VALUE, base-type=/Composite/SignedWord
    FixedWords: category=ARRAY
      element element: array-size=2, array-size-semantics=FIXED-SIZE, implementation-data-type=/Composite/WordValue
    BoundedBytes: category=ARRAY
      element element: array-size=3, array-size-semantics=VARIABLE-SIZE, implementation-data-type=/Composite/ByteValue
    InlineMatrix: category=ARRAY
      element row: category=ARRAY, array-size=2, array-size-semantics=FIXED-SIZE
        element column: category=VALUE, array-size=3, array-size-semantics=FIXED-SIZE, base-type=/Composite/Byte
    Nested: category=STRUCTURE
      element temperature: implementation-data-type=/Composite/SignedValue
    Envelope: category=STRUCTURE
      5 x element, all with category=TYPE_REFERENCE:
        tag: implementation-data-type=/Composite/ByteValue
        samples: implementation-data-type=/Composite/FixedWords
        bytes: implementation-data-type=/Composite/BoundedBytes
        matrix: implementation-data-type=/Composite/InlineMatrix
        nested: implementation-data-type=/Composite/Nested
  app type LogicalWord: category=VALUE
  data type mapping set TypeMap: data-type-map{application-data-type=/Composite/LogicalWord, implementation-data-type=/Composite/WordValue}
  service interface EnvelopeService
    methods:
      operation Transform
        arg payload: type=/Composite/Envelope, direction=INOUT
      operation MappedScalar
        arg value: type=/Composite/LogicalWord, direction=INOUT
    events:
      data EnvelopeChanged: type=/Composite/Envelope
    field EnvelopeState
      data EnvelopeState: type=/Composite/Envelope
  someip service interface deployment EnvelopeDeployment: service-interface=/Composite/EnvelopeService, service-interface-id=0x3456, major-version=1, minor-version=0
    someip method deployment Transform: method=/Composite/EnvelopeService/Transform, method-id=1
    someip method deployment MappedScalar: method=/Composite/EnvelopeService/MappedScalar, method-id=2
    someip event deployment Changed: event=/Composite/EnvelopeService/EnvelopeChanged, event-id=0x8001
    someip field deployment State: field=/Composite/EnvelopeService/EnvelopeState, getter-id=0x0101, setter-id=0x0102, notifier-id=0x8101
    someip event group Changes: event-group-id=1, event=/Composite/EnvelopeService/EnvelopeChanged, field-deployment=/Composite/EnvelopeDeployment/State
  provided someip service instance EnvelopeInstance: service-interface-deployment=/Composite/EnvelopeDeployment, service-instance-id=1
  ap someip transformation props Layout: byte-order=big-endian, alignment=8, size-of-struct-length-field=2, size-of-array-length-field=2
  transformation props to service interface element mapping Serialization: transformation-props=/Composite/Layout, method=/Composite/EnvelopeService/Transform, method=/Composite/EnvelopeService/MappedScalar, event=/Composite/EnvelopeService/EnvelopeChanged, field=/Composite/EnvelopeService/EnvelopeState
